#include "webconfig.h"

#include <ArduinoJson.h>
#include <DNSServer.h>
#include <HTTPClient.h>
#include <Update.h>
#include <WebServer.h>
#include <WiFi.h>
#include <WiFiClientSecure.h>

#include "settings.h"
#include "web_page.h" // generated by tools/build_web.py (INDEX_HTML_GZ)

static WebServer server(80);
static DNSServer dns;
static bool portalActive = false;
static uint32_t restartAtMs = 0; // 0 = no restart pending
static std::function<bool(const StopConfig *, size_t)> stopsChangedCb;

// Restart a beat after the current handler returns so the response flushes.
static void scheduleRestart() { restartAtMs = millis() + 1500; }

static void sendJson(int code, const String &body) {
  server.send(code, "application/json", body);
}

static void sendError(int code, const char *msg) {
  JsonDocument doc;
  doc["error"] = msg;
  String out;
  serializeJson(doc, out);
  sendJson(code, out);
}

// ---- UI + status --------------------------------------------------------------

static void handleRoot() {
  server.sendHeader("Content-Encoding", "gzip");
  server.sendHeader("Cache-Control", "no-cache");
  server.send_P(200, "text/html", (const char *)INDEX_HTML_GZ,
                INDEX_HTML_GZ_LEN);
}

static void handleStatus() {
  JsonDocument doc;
  doc["version"] = FW_VERSION;
  doc["uptimeS"] = millis() / 1000;
  doc["heap"] = ESP.getFreeHeap();
  doc["mode"] = portalActive ? "portal" : "sta";
  doc["ssid"] = WiFi.SSID();
  doc["ip"] = portalActive && WiFi.status() != WL_CONNECTED
                  ? WiFi.softAPIP().toString()
                  : WiFi.localIP().toString();
  doc["rssi"] = WiFi.RSSI();
  doc["stops"] = gStopCount;
  String out;
  serializeJson(doc, out);
  sendJson(200, out);
}

// ---- Stop configuration ---------------------------------------------------------

static void handleConfigGet() { sendJson(200, settingsStopsJson()); }

static void handleConfigPost() {
  StopConfig stops[MAX_STOPS];
  size_t count = 0;
  if (!settingsParseStops(server.arg("plain"), stops, count)) {
    sendError(400, "invalid stop list");
    return;
  }
  if (!stopsChangedCb || !stopsChangedCb(stops, count)) {
    sendError(500, "failed to save");
    return;
  }
  Serial.printf("[web] stop list updated (%u stops)\r\n", (unsigned)count);
  sendJson(200, "{\"ok\":true}");
}

// ---- Screen-sleep schedule ------------------------------------------------------

static void handleScreenGet() {
  JsonDocument doc;
  doc["en"] = gScreen.sleepEnabled;
  doc["off"] = gScreen.offHour;
  doc["on"] = gScreen.onHour;
  doc["wake"] = gScreen.wakeSecs;
  String out;
  serializeJson(doc, out);
  sendJson(200, out);
}

static void handleScreenPost() {
  JsonDocument doc;
  if (deserializeJson(doc, server.arg("plain")) != DeserializationError::Ok) {
    sendError(400, "invalid json");
    return;
  }
  ScreenSettings s;
  s.sleepEnabled = doc["en"] | false;
  int off = doc["off"] | -1, on = doc["on"] | -1, wake = doc["wake"] | -1;
  if (off < 0 || off > 23 || on < 0 || on > 23 || wake < 5 || wake > 3600) {
    sendError(400, "invalid schedule");
    return;
  }
  s.offHour = (uint8_t)off;
  s.onHour = (uint8_t)on;
  s.wakeSecs = (uint16_t)wake;
  settingsSaveScreen(s); // main loop picks it up on its next pass
  Serial.printf("[web] screen schedule: %s %02d:00-%02d:00, wake %ds\r\n",
                s.sleepEnabled ? "sleep" : "always on", s.offHour, s.onHour,
                s.wakeSecs);
  sendJson(200, "{\"ok\":true}");
}

// ---- WiFi provisioning ----------------------------------------------------------

static void handleWifiScan() {
  // Blocks ~2s; fine for the single-user config page. Portal mode already
  // runs WIFI_AP_STA, which scanNetworks requires alongside the AP.
  int n = WiFi.scanNetworks();
  JsonDocument doc;
  JsonArray arr = doc.to<JsonArray>();
  for (int i = 0; i < n && i < 30; i++) {
    if (WiFi.SSID(i).isEmpty()) {
      continue;
    }
    JsonObject net = arr.add<JsonObject>();
    net["ssid"] = WiFi.SSID(i);
    net["rssi"] = WiFi.RSSI(i);
    net["open"] = WiFi.encryptionType(i) == WIFI_AUTH_OPEN;
  }
  WiFi.scanDelete();
  String out;
  serializeJson(doc, out);
  sendJson(200, out);
}

static void handleWifiPost() {
  JsonDocument doc;
  if (deserializeJson(doc, server.arg("plain")) != DeserializationError::Ok) {
    sendError(400, "invalid json");
    return;
  }
  const char *ssid = doc["ssid"];
  const char *pass = doc["pass"] | "";
  if (ssid == nullptr || ssid[0] == '\0' || strlen(ssid) > 32 ||
      strlen(pass) > 64) {
    sendError(400, "invalid credentials");
    return;
  }
  settingsSetWifi(ssid, pass);
  Serial.printf("[web] WiFi credentials saved for \"%s\", restarting\r\n", ssid);
  sendJson(200, "{\"ok\":true,\"restarting\":true}");
  scheduleRestart();
}

// ---- NextBus proxy --------------------------------------------------------------
// The browser can't call retro.umoiq.com itself (no CORS header, and the
// page is plain HTTP on the LAN while the feed is HTTPS), so the two picker
// queries are proxied here, streamed through in chunks without buffering.

static void proxyNextBus(const String &upstreamQuery) {
  if (WiFi.status() != WL_CONNECTED) {
    sendError(503, "no internet connection yet");
    return;
  }
  WiFiClientSecure client;
  client.setInsecure(); // same public-data policy as transit_data.cpp

  HTTPClient http;
  http.useHTTP10(true); // raw stream, no chunked decoding needed
  http.setTimeout(HTTP_TIMEOUT_MS);
  http.setUserAgent(HTTP_USER_AGENT);
  String url = String("https://retro.umoiq.com/service/publicJSONFeed?a=ttc&") +
               upstreamQuery;
  if (!http.begin(client, url) || http.GET() != HTTP_CODE_OK) {
    http.end();
    sendError(502, "upstream request failed");
    return;
  }

  server.setContentLength(CONTENT_LENGTH_UNKNOWN); // chunked to the browser
  server.send(200, "application/json", "");
  WiFiClient &in = http.getStream();
  uint8_t buf[1024];
  int remaining = http.getSize(); // -1 when unknown (read until close)
  while (http.connected() && remaining != 0) {
    size_t got = in.readBytes(buf, sizeof(buf));
    if (got == 0) {
      break;
    }
    server.sendContent((const char *)buf, got);
    if (remaining > 0) {
      remaining -= got;
    }
  }
  server.sendContent(""); // terminate the chunked response
  http.end();
}

static void handleNextBusRoutes() { proxyNextBus("command=routeList"); }

static void handleNextBusRoute() {
  String r = server.arg("r");
  if (r.isEmpty() || r.length() > ROUTE_MAX_LEN) {
    sendError(400, "missing route");
    return;
  }
  for (size_t i = 0; i < r.length(); i++) {
    if (!isAlphaNumeric(r[i])) {
      sendError(400, "invalid route");
      return;
    }
  }
  proxyNextBus(String("command=routeConfig&terse=true&r=") + r);
}

// ---- OTA firmware upload --------------------------------------------------------

static void handleUpdateDone() {
  bool ok = !Update.hasError();
  server.sendHeader("Connection", "close");
  if (ok) {
    sendJson(200, "{\"ok\":true}");
    Serial.println("[web] OTA update complete, restarting");
    scheduleRestart();
  } else {
    sendError(500, Update.errorString());
  }
}

static void handleUpdateUpload() {
  HTTPUpload &up = server.upload();
  if (up.status == UPLOAD_FILE_START) {
    Serial.printf("[web] OTA upload start: %s\r\n", up.filename.c_str());
    // Sizes the write to the free OTA slot; validates the image magic on the
    // first chunk, so garbage uploads fail without touching the running app.
    if (!Update.begin(UPDATE_SIZE_UNKNOWN, U_FLASH)) {
      Update.printError(Serial);
    }
  } else if (up.status == UPLOAD_FILE_WRITE) {
    if (Update.write(up.buf, up.currentSize) != up.currentSize) {
      Update.printError(Serial);
    }
  } else if (up.status == UPLOAD_FILE_END) {
    if (Update.end(true)) { // true = set the new slot as boot partition
      Serial.printf("[web] OTA upload done: %u bytes\r\n", up.totalSize);
    } else {
      Update.printError(Serial);
    }
  } else if (up.status == UPLOAD_FILE_ABORTED) {
    Update.abort();
    Serial.println("[web] OTA upload aborted");
  }
}

// ---- Captive portal -------------------------------------------------------------

// OS connectivity probes (Android/iOS/Windows/Firefox). Redirecting them to
// the portal page is what makes the "sign in to network" sheet pop up.
static const char *const PROBE_PATHS[] = {
    "/generate_204",  "/gen_204",     "/hotspot-detect.html",
    "/connecttest.txt", "/ncsi.txt",  "/success.txt",
    "/canonical.html", "/redirect",   "/library/test/success.html",
};

static void handleCaptive() {
  if (!portalActive) {
    server.send(404, "text/plain", "not found");
    return;
  }
  server.sendHeader("Location",
                    String("http://") + WiFi.softAPIP().toString() + "/");
  server.send(302, "text/plain", "");
}

// ---- Public API -----------------------------------------------------------------

void webconfigBegin(
    std::function<bool(const StopConfig *, size_t)> onStopsChanged) {
  stopsChangedCb = onStopsChanged;

  server.on("/", HTTP_GET, handleRoot);
  server.on("/api/status", HTTP_GET, handleStatus);
  server.on("/api/config", HTTP_GET, handleConfigGet);
  server.on("/api/config", HTTP_POST, handleConfigPost);
  server.on("/api/screen", HTTP_GET, handleScreenGet);
  server.on("/api/screen", HTTP_POST, handleScreenPost);
  server.on("/api/wifi/scan", HTTP_GET, handleWifiScan);
  server.on("/api/wifi", HTTP_POST, handleWifiPost);
  server.on("/api/nextbus/routes", HTTP_GET, handleNextBusRoutes);
  server.on("/api/nextbus/route", HTTP_GET, handleNextBusRoute);
  server.on("/update", HTTP_POST, handleUpdateDone, handleUpdateUpload);
  server.on("/api/reboot", HTTP_POST, [] {
    sendJson(200, "{\"ok\":true}");
    scheduleRestart();
  });
  for (const char *path : PROBE_PATHS) {
    server.on(path, HTTP_GET, handleCaptive);
  }
  server.onNotFound(handleCaptive);

  server.begin();
  Serial.println("[web] server started on :80");
}

void webconfigTick() {
  if (portalActive) {
    dns.processNextRequest();
  }
  server.handleClient();
  if (restartAtMs != 0 && (int32_t)(millis() - restartAtMs) >= 0) {
    ESP.restart();
  }
}

void webconfigStartPortal() {
  if (portalActive) {
    return;
  }
  // AP_STA (not pure AP) so stored credentials can keep being retried in the
  // background and /api/wifi/scan works.
  WiFi.mode(WIFI_AP_STA);
  WiFi.softAP(AP_SSID);
  dns.start(53, "*", WiFi.softAPIP());
  portalActive = true;
  Serial.printf("[web] portal up: \"%s\" -> http://%s/\r\n", AP_SSID,
                WiFi.softAPIP().toString().c_str());
}

void webconfigStopPortal() {
  if (!portalActive) {
    return;
  }
  dns.stop();
  WiFi.softAPdisconnect(true);
  WiFi.mode(WIFI_STA);
  portalActive = false;
  Serial.println("[web] portal down");
}

bool webconfigPortalActive() { return portalActive; }
